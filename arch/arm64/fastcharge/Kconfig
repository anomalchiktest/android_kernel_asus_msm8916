## arch/arm64/fastcharge/Kconfig
```kconfig
config FAST_CHARGE
	bool "Force faster charge rate for AC/USB"
	default y
	help
	  This allows users to override default charge rate for both USB and AC
	  charger input current

config FORCE_FAST_CHARGE
	bool "Force faster charge rate for AC/USB"
	default y
	help
	  Force Enabled Fast Charge
	  charger input current
```
